## base_external/package/aesd-assignments/Config.in
```kconfig
config BR2_PACKAGE_AESD_ASSIGNMENTS
	bool "aesd-assignments"
	select BR2_PACKAGE_LIBOPENSSL
	select BR2_PACKAGE_LIBOPENSSL_BIN
	select BR2_PACKAGE_PAHO_MQTT_C
	help
	  Includes the writer executable, finder.sh and tester.sh in the kernel image.
	  Used to understand buildroot external trees and package builds.
```
